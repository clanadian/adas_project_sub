## arty/classifier_linux_eb/project-spec/configs/rootfsconfigs/Kconfig.user
```kconfig
menu "user packages " 
config adas-classifier  
	 bool "adas-classifier"
	 help
	
config gpio-demo  
	 bool "gpio-demo"
	 help
	
config peekpoke  
	 bool "peekpoke"
	 help
	
endmenu
```
