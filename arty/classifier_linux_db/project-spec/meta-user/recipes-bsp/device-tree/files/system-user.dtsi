/include/ "system-conf.dtsi"

&amba {
    classifier@40000000 {
        compatible = "adas,classifier-1.0";
        reg = <0x40000000 0x10000>,
              <0x40010000 0x10000>;
        reg-names = "arguments", "execution";
        status = "okay";
    };
};
